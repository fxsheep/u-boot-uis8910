/dts-v1/;

#include "skeleton.dtsi"

/ {
	model = "Unisoc UIS8910";
	compatible = "Unisoc,uis8910", "rda,rda8910m";

	aliases {
		console = "/serial1@50098000";
	};

	uart1: serial1@50098000 {
		compatible = "unisoc,uis8910-uart";
		reg = <0x50098000 0x1000>;
	};

	sram@800000 {
		device_type = "memory";
		reg = <0x800000 0x40000>;
	};

};

