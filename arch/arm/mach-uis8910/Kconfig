## arch/arm/mach-uis8910/Kconfig
```kconfig
if ARCH_UIS8910

choice
	prompt "UIS8910 board select"
	optional

config TARGET_UIS8910
	bool "Support generic UIS8910"
	select OF_CONTROL

endchoice

config SYS_SOC
	default "uis8910"

source "board/unisoc/uis8910/Kconfig"

endif
```

## board/unisoc/uis8910/Kconfig
```kconfig
if TARGET_UIS8910

config SYS_BOARD
  default "uis8910"

config SYS_VENDOR
  default "unisoc"

config SYS_CONFIG_NAME
  default "uis8910"

endif
```

## configs/uis8910_defconfig
```kconfig
CONFIG_ARM=y
CONFIG_ARCH_UIS8910=y
CONFIG_TARGET_UIS8910=y
CONFIG_DM=y
CONFIG_UIS8910_UART=y
CONFIG_SYS_TEXT_BASE=0x810040
CONFIG_NR_DRAM_BANKS=1
CONFIG_DEFAULT_DEVICE_TREE="uis8910"
```
